/include/ "system-conf.dtsi"
/ {
	chosen {
		bootargs = " earlycon console=ttyPS0,115200 clk_ignore_unused root=/dev/ram0 rw";
		stdout-path = "serial0:115200n8";
		xlnx,eeprom = &eeprom;
	};
};
/ {
	axi_stream_dma_0@b0000000 {
		compatible = "axi_stream_dma";
		reg = <0x0 0xb0000000 0x0 0x10000>;
		interrupts = <0 89 4>;
		interrupt-parent = <&gic>;
	};
};
